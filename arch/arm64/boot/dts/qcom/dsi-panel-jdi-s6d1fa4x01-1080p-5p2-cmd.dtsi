/*
 * Copyright (c) 2015, The Linux Foundation. All rights reserved.
 *
 * This program is free software; you can redistribute it and/or modify
 * it under the terms of the GNU General Public License version 2 and
 * only version 2 as published by the Free Software Foundation.
 *
 * This program is distributed in the hope that it will be useful,
 * but WITHOUT ANY WARRANTY; without even the implied warranty of
 * MERCHANTABILITY or FITNESS FOR A PARTICULAR PURPOSE.  See the
 * GNU General Public License for more details.
 */

/*---------------------------------------------------------------------------
 * This file is autogenerated file using gcdb parser. Please do not edit it.
 * Update input XML file to add a new entry or update variable in this file
 * VERSION = "1.0"
 *---------------------------------------------------------------------------*/
&mdss_mdp {
	dsi_jdi_s6d1fa4x01_1080p_5p2_cmd: qcom,mdss_dsi_jdi_s6d1fa4x01_1080p_5p2_cmd {
		qcom,mdss-dsi-panel-name = "jdi s6d1fa4x01 1080p 5p2 cmd dsi panel";
		qcom,mdss-dsi-panel-type = "dsi_cmd_mode";
		qcom,mdss-dsi-panel-framerate = <60>;
		qcom,mdss-dsi-virtual-channel-id = <0>;
		qcom,mdss-dsi-stream = <0>;
		qcom,mdss-dsi-panel-width = <1080>;
		qcom,mdss-dsi-panel-height = <1920>;
		qcom,mdss-dsi-h-front-porch = <168>;
		qcom,mdss-dsi-h-back-porch = <44>;
		qcom,mdss-dsi-h-pulse-width = <8>;
		qcom,mdss-dsi-h-sync-skew = <0>;
		qcom,mdss-dsi-v-back-porch = <3>;
		qcom,mdss-dsi-v-front-porch = <4>;
		qcom,mdss-dsi-v-pulse-width = <1>;
		qcom,mdss-dsi-h-left-border = <0>;
		qcom,mdss-dsi-h-right-border = <0>;
		qcom,mdss-dsi-v-top-border = <0>;
		qcom,mdss-dsi-v-bottom-border = <0>;
		qcom,mdss-dsi-bpp = <24>;
		qcom,mdss-dsi-color-order = "rgb_swap_rgb";
		qcom,mdss-dsi-underflow-color = <0xff>;
		qcom,mdss-dsi-border-color = <0>;
		qcom,mdss-dsi-on-command = [
			39 01 00 00 78 00 02 11 00

			//te related
			39 01 00 00 00 00 03 44 07 76

			39 01 00 00 00 00 03 f0 5a 5a
			39 01 00 00 00 00 03 f1 5a 5a
			39 01 00 00 00 00 03 fc 5a 5a
	
			//39 01 00 00 00 00 09 c4 00 00 ff 31 00 52 03 62 //cabc dimming min
			//39 01 00 00 00 00 09 c4 00 00 ff 3f 00 52 03 62 //cabc dimming max
			//39 01 00 00 00 00 09 c4 70 00 ff 3f 00 ff 03 70 //cabc mode0
			39 01 00 00 00 00 09 c4 01 01 ff 3f 00 ff 03 70 //cabc mode1
	
			//samsung for esd
			//39 01 00 00 00 00 05 bc 08 48 4f 5c
			//39 01 00 00 00 00 2d f4 50 50 00 14 14 14 14 05 10 1c 0e 00 14 05 c0 02 68 05 54 aa 55 04 00 44 30 10 1e 5e 1e a0 ac 00 95 26 3a 5a 15 fa 40 1c 9c 00 00 00
			39 01 00 00 00 00 08 fd 00 00 00 00 00 00 08

			//gamma 2.2
			//39 01 00 00 00 00 02 D0 08
			//39 01 00 00 00 00 3D EA 00 7F 09 12 1A 21 38 51 5C 61 A4 8B 99 A4 AF BC 50 5B 6B 77 1F 7F 06 0C 11 17 29 3D 45 4A 8E 77 89 99 A5 B3 49 56 68 76 36 7F 05 09 0D 11 20 31 35 39 7E 69 7D 90 9D AD 44 52 66 75
	
			39 01 00 00 00 00 03 f0 a5 a5
			39 01 00 00 00 00 03 f1 a5 a5
			39 01 00 00 00 00 03 fc a5 a5

			//cabc
			39 01 00 00 00 00 02 51 00
			39 01 00 00 00 00 02 53 2C
			39 01 00 00 00 00 02 55 00
	
	
			39 01 00 00 00 00 02 35 00
			39 01 00 00 00 00 02 29 00];

		qcom,mdss-dsi-off-command = [39 01 00 00 00 00 02 28 00
					39 01 00 00 78 00 02 10 00];
		qcom,mdss-dsi-on-command-state = "dsi_lp_mode";
		qcom,mdss-dsi-off-command-state = "dsi_hs_mode";

		qcom,mdss-dsi-h-sync-pulse = <0>;
		qcom,mdss-dsi-traffic-mode = "burst_mode";
		qcom,mdss-dsi-lane-map = "lane_map_0123";
		qcom,mdss-dsi-bllp-eof-power-mode;
		qcom,mdss-dsi-bllp-power-mode;
		qcom,mdss-dsi-lane-0-state;
		qcom,mdss-dsi-lane-1-state;
		qcom,mdss-dsi-lane-2-state;
		qcom,mdss-dsi-lane-3-state;
		qcom,mdss-dsi-te-pin-select = <1>;
		qcom,mdss-dsi-te-dcs-command = <1>;
		qcom,mdss-dsi-te-check-enable;
		qcom,mdss-dsi-te-using-te-pin;
		qcom,mdss-dsi-panel-timings = [6E 3F 36 00 5A 4F 38 41 54 03 04 00];
		qcom,mdss-dsi-panel-timings-phy-v2 = [
			24 1f 08 09 05 03 04 a0
			24 1f 08 09 05 03 04 a0
			24 1f 08 09 05 03 04 a0
			24 1f 08 09 05 03 04 a0
			24 1b 08 09 05 03 04 a0];
		qcom,mdss-dsi-t-clk-post = <0x0d>;
		qcom,mdss-dsi-t-clk-pre = <0x30>;
		qcom,mdss-dsi-dma-trigger = "trigger_sw";
		qcom,mdss-dsi-mdp-trigger = "none";
		qcom,mdss-dsi-bl-pmic-control-type = "bl_ctrl_wled";
		qcom,mdss-dsi-bl-min-level = <1>;
		qcom,mdss-dsi-bl-max-level = <4095>;
		qcom,mdss-dsi-reset-sequence = <1 10>, <0 5>, <1 10>;
		qcom,mdss-pan-physical-width-dimension = <65>;
		qcom,mdss-pan-physical-height-dimension = <115>;
	};
};
