## drivers/hwmon/nubia_sensors/Kconfig
```kconfig
################################################# SENSORS START
menuconfig NUBIA_SENSORS
	tristate "NUBIA SENSORS ON"
	default n
	help
		nubia senor

if NUBIA_SENSORS

config FEATURE_NUBIA_SENSORS_LOG_ON
	tristate "NUBIA SENSORS LOG ON"
	depends on NUBIA_SENSORS
	default n
	help
		If you want to enable the sensor log,
		then choose this config

################################################# PROX START
config NUBIA_SENSORS_PROX_PA224
	tristate "support txc pa224 prox sensor driver"
	depends on NUBIA_SENSORS
	default n
	help
		nubia prox device (TXC PA224)

################################################# RGB START
config NUBIA_SENSORS_RGB_BH1745
	tristate "support rgb bh1745 driver"
	depends on NUBIA_SENSORS
	default n
	help
		nubia rgb device (ROHM BH1745)

endif
```

## drivers/input/fingerprint/goodix_gf3208/Kconfig
```kconfig
config FINGERPRINT_GOODIX_GF3208
	tristate "Goodix GF3208 fingerprint driver (nx549j)"
	depends on INPUT_FINGERPRINT
	help
	  Say Y here to enable the Goodix GF3208 fingerprint sensor driver
	  for Nubia Z11 mini S (nx549j / MSM8953). Uses SoC platform bus
	  with GPIO IRQ/RST/PWR. Requires Nubia-signed trustlet for full
	  biometric functionality.
```

## drivers/platform/xiaomi/Kconfig
```kconfig
# Xiaomi configuration options

config MACH_XIAOMI_MSM8953
	bool "Xiaomi MSM8953"
	depends on ARCH_MSM8953
	help
	  Support for MSM8953 Xiaomi variants

menu "Xiaomi board selection"

config MACH_XIAOMI_MIDO
        bool "Mido board"
        select MACH_XIAOMI_MSM8953
        help
          Support for Xiaomi Redmi note 3

config MACH_XIAOMI_TISSOT
	bool "Tissot board"
	select MACH_XIAOMI_MSM8953
	help
	  Support for Xiomi MI A1 tissot

config MACH_NUBIA_NX549J
	bool "Nubia NX549J board"
	select MACH_XIAOMI_MSM8953
	help
	  Support for Nubia Z17 mini (NX549J).
	  Reuses Xiaomi MSM8953 platform glue while nubia-specific drivers
	  are deferred (panels/touch/FP wired in later waves).

endmenu
```
